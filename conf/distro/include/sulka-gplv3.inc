## conf/distro/sulka.conf
```bitbake
DISTRO = "sulka"
DISTRO_NAME = "Sulka"
DISTRO_VERSION = "0.6.0"
DISTRO_CODENAME = "Albatross"

TARGET_VENDOR = "-sulka"

SDK_VENDOR = "-sulkasdk"
SDK_VERSION="${DISTRO_VERSION}"

MAINTAINER = "ejaaskel <esa.jaaskela@suomi24.fi>"

LOCALCONF_VERSION = "2"

TCLIBCAPPEND = ""

PACKAGE_CLASSES ?= "package_rpm"

INIT_MANAGER ?= "systemd"

require conf/distro/include/no-static-libs.inc
require conf/distro/include/yocto-uninative.inc

INHERIT += "uninative"

BB_SIGNATURE_HANDLER ?= "OEEquivHash"
BB_HASHSERVE ??= "auto"

require conf/distro/include/sulka-hardening.inc
```

## conf/layer.conf
```bitbake
# We have a conf and classes directory, add to BBPATH
BBPATH .= ":${LAYERDIR}"

# We have recipes-* directories, add to BBFILES
BBFILES += "${LAYERDIR}/recipes-*/*/*.bb \
            ${LAYERDIR}/recipes-*/*/*.bbappend"

BBFILE_COLLECTIONS += "meta-sulka-distro"
BBFILE_PATTERN_meta-sulka-distro = "^${LAYERDIR}/"
BBFILE_PRIORITY_meta-sulka-distro = "11"

LAYERDEPENDS_meta-sulka-distro = "core networking-layer security"
LAYERDEPENDS_meta-sulka-distro:append = "${@" selinux " if d.getVar('SULKA_MANDATORY_ACCESS_CONTROL_MODULE') == "selinux" else ""}"
LAYERDEPENDS_meta-sulka-distro:append = "${@" meta-sulka-kernel " if d.getVar('SULKA_HARDEN_KERNEL') == "1" \
                                                                  or d.getVar('SULKA_DISABLE_GRAPHICS') == "1" \
                                                                  else ""}"


LAYERSERIES_COMPAT_meta-sulka-distro = "wrynose"
```
